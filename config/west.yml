## config/west.yml
```yaml
manifest:
  remotes:
    - name: zmkfirmware
      url-base: https://github.com/zmkfirmware
    - name: sqdbruh
      url-base: https://github.com/sqdbruh
  projects:
    - name: zmk
      remote: sqdbruh
      revision: v0.3-branch
      import: app/west.yml
  self:
    path: config
```
